## defconfig
```kconfig
BR2_arm=y
BR2_cortex_a7=y
BR2_ARM_FPU_NEON_VFPV4=y
BR2_ARM_INSTRUCTIONS_THUMB2=y
BR2_KERNEL_MIRROR="https://www.kernel.org/pub"
BR2_GNU_MIRROR="http://ftp.gnu.org/pub/gnu"
# BR2_COMPILER_PARANOID_UNSAFE_PATH is not set
BR2_PACKAGE_HOST_LINUX_HEADERS_CUSTOM_4_9=y
BR2_TOOLCHAIN_BUILDROOT_LOCALE=y
BR2_PTHREAD_DEBUG=y
# BR2_UCLIBC_INSTALL_UTILS is not set
BR2_TOOLCHAIN_BUILDROOT_CXX=y
BR2_PACKAGE_HOST_GDB=y
BR2_ROOTFS_DEVICE_CREATION_DYNAMIC_EUDEV=y
BR2_TARGET_GENERIC_ROOT_PASSWD="root"
# BR2_TARGET_GENERIC_REMOUNT_ROOTFS_RW is not set
# BR2_ENABLE_LOCALE_PURGE is not set
BR2_ROOTFS_POST_BUILD_SCRIPT="board/starterkit/imx6sk-min/post-build-nano-2eth.sh"
BR2_LINUX_KERNEL=y
BR2_LINUX_KERNEL_CUSTOM_TARBALL=y
BR2_LINUX_KERNEL_CUSTOM_TARBALL_LOCATION="linux_imx_4.9.x_1.0.0_ga-sk.tar.bz2"
BR2_LINUX_KERNEL_USE_CUSTOM_CONFIG=y
BR2_LINUX_KERNEL_CUSTOM_CONFIG_FILE="Custom/linux-config"
BR2_LINUX_KERNEL_LZO=y
BR2_LINUX_KERNEL_DTS_SUPPORT=y
BR2_LINUX_KERNEL_INTREE_DTS_NAME="imx6ull-sk-nano-2eth"
BR2_LINUX_KERNEL_INSTALL_TARGET=y
BR2_PACKAGE_BUSYBOX_SHOW_OTHERS=y
BR2_PACKAGE_EMERGUNIT=y
BR2_PACKAGE_ALSA_UTILS=y
BR2_PACKAGE_ALSA_UTILS_ALSACONF=y
BR2_PACKAGE_ALSA_UTILS_AMIXER=y
BR2_PACKAGE_ALSA_UTILS_APLAY=y
BR2_PACKAGE_MADPLAY=y
BR2_PACKAGE_SOX=y
BR2_PACKAGE_GZIP=y
BR2_PACKAGE_GDB=y
BR2_PACKAGE_LIBTOOL=y
BR2_PACKAGE_MTD=y
BR2_PACKAGE_QT5=y
BR2_PACKAGE_QT5BASE_GUI=y
BR2_PACKAGE_QT5SERIALBUS=y
BR2_PACKAGE_QT5WEBSOCKETS=y
BR2_PACKAGE_LIBWT=y
BR2_PACKAGE_FREESCALE_IMX=y
BR2_PACKAGE_GPIO_WATCH=y
BR2_PACKAGE_I2C_TOOLS=y
BR2_PACKAGE_MEMTESTER=y
BR2_PACKAGE_PARTED=y
BR2_PACKAGE_RS485_TEST=y
BR2_PACKAGE_SPI_TOOLS=y
BR2_PACKAGE_UBOOT_TOOLS=y
BR2_PACKAGE_PYTHON3=y
BR2_PACKAGE_PYTHON_ALSAAUDIO=y
BR2_PACKAGE_PYTHON_NETIFACES=y
BR2_PACKAGE_PYTHON_PAHO_MQTT=y
BR2_PACKAGE_PYTHON_PARAMIKO=y
BR2_PACKAGE_PYTHON_PSUTIL=y
BR2_PACKAGE_PYTHON_REQUESTS=y
BR2_PACKAGE_PYTHON_SIP=y
BR2_PACKAGE_BCG729=y
BR2_PACKAGE_LIBG7221=y
BR2_PACKAGE_LIBGSM=y
BR2_PACKAGE_LIBSNDFILE=y
BR2_PACKAGE_OPUSFILE=y
BR2_PACKAGE_SPANDSP=y
BR2_PACKAGE_SPEEX=y
BR2_PACKAGE_SPEEXDSP=y
BR2_PACKAGE_WEBRTC_AUDIO_PROCESSING=y
BR2_PACKAGE_LIBSSH=y
BR2_PACKAGE_MBEDTLS_PROGRAMS=y
BR2_PACKAGE_MBEDTLS_COMPRESSION=y
BR2_PACKAGE_OPENSSL_BIN=y
BR2_PACKAGE_JSON_C=y
BR2_PACKAGE_LIBEXOSIP2=y
BR2_PACKAGE_LIBNL=y
BR2_PACKAGE_LIBNL_TOOLS=y
BR2_PACKAGE_BOOST=y
BR2_PACKAGE_BOOST_ATOMIC=y
BR2_PACKAGE_BOOST_CHRONO=y
BR2_PACKAGE_BOOST_CONTAINER=y
BR2_PACKAGE_BOOST_CONTEXT=y
BR2_PACKAGE_BOOST_COROUTINE=y
BR2_PACKAGE_BOOST_COROUTINE2=y
BR2_PACKAGE_BOOST_DATE_TIME=y
BR2_PACKAGE_BOOST_EXCEPTION=y
BR2_PACKAGE_BOOST_FILESYSTEM=y
BR2_PACKAGE_BOOST_IOSTREAMS=y
BR2_PACKAGE_BOOST_LOCALE=y
BR2_PACKAGE_BOOST_MATH=y
BR2_PACKAGE_BOOST_METAPARSE=y
BR2_PACKAGE_BOOST_MPI=y
BR2_PACKAGE_BOOST_PROGRAM_OPTIONS=y
BR2_PACKAGE_BOOST_RANDOM=y
BR2_PACKAGE_BOOST_SIGNALS=y
BR2_PACKAGE_BOOST_SYSTEM=y
BR2_PACKAGE_BOOST_THREAD=y
BR2_PACKAGE_BOOST_TIMER=y
BR2_PACKAGE_FFTW=y
BR2_PACKAGE_PCRE_16=y
BR2_PACKAGE_PCRE_32=y
BR2_PACKAGE_CAN_UTILS=y
BR2_PACKAGE_DROPBEAR=y
BR2_PACKAGE_DROPBEAR_DISABLE_REVERSEDNS=y
BR2_PACKAGE_IPROUTE2=y
BR2_PACKAGE_IPTABLES=y
BR2_PACKAGE_LINPHONE4=y
BR2_PACKAGE_LLDPD=y
BR2_PACKAGE_NTP=y
BR2_PACKAGE_OPENSSH=y
BR2_PACKAGE_OPENVPN=y
BR2_PACKAGE_RSYNC=y
BR2_PACKAGE_TCPDUMP=y
BR2_PACKAGE_VSFTPD=y
BR2_PACKAGE_LESS=y
BR2_PACKAGE_MC=y
BR2_TARGET_UBOOT=y
BR2_TARGET_UBOOT_SK_IMX6ULL_NANO_2ETH=y
BR2_TARGET_UBOOT_BUILD_SYSTEM_KCONFIG=y
BR2_TARGET_UBOOT_CUSTOM_TARBALL=y
BR2_TARGET_UBOOT_CUSTOM_TARBALL_LOCATION="uboot_imx_4.9.x_1.0.0_ga-sk.tar.bz2"
BR2_TARGET_UBOOT_NEEDS_DTC=y
# BR2_TARGET_UBOOT_FORMAT_BIN is not set
BR2_TARGET_UBOOT_FORMAT_IMX=y
```

## package/bctoolbox4/Config.in
```kconfig
config BR2_PACKAGE_BCTOOLBOX4
	bool "bctoolbox4"
	depends on BR2_INSTALL_LIBSTDCPP
	depends on BR2_TOOLCHAIN_HAS_THREADS
	depends on !BR2_TOOLCHAIN_HAS_GCC_BUG_64735 # exception_ptr
	depends on !BR2_PACKAGE_BCTOOLBOX
	select BR2_PACKAGE_LIBICONV if !BR2_ENABLE_LOCALE
	help
	  Utilities library used by Belledonne Communications
	  softwares like belle-sip, mediastreamer2 and linphone.

	  Select BR2_PACKAGE_MBEDTLS4 for crypto support.

	  https://github.com/BelledonneCommunications/bctoolbox

comment "bctoolbox needs a toolchain w/ C++, threads"
	depends on !BR2_INSTALL_LIBSTDCPP || !BR2_TOOLCHAIN_HAS_THREADS

comment "bctoolbox needs a toolchain not affected by GCC bug 64735"
	depends on BR2_TOOLCHAIN_HAS_GCC_BUG_64735
```

## package/belle-sip4/Config.in
```kconfig
config BR2_PACKAGE_BELLE_SIP4
	bool "belle-sip4"
	depends on BR2_INSTALL_LIBSTDCPP
	depends on !BR2_STATIC_LIBS # dlfcn.h
	depends on BR2_TOOLCHAIN_HAS_THREADS
	depends on !BR2_TOOLCHAIN_HAS_GCC_BUG_64735 # bctoolbox
	depends on BR2_USE_WCHAR
	depends on !BR2_PACKAGE_BCTOOLBOX
	select BR2_PACKAGE_BCTOOLBOX4
	# needs crypto support in bctoolbox
	select BR2_PACKAGE_MBEDTLS4
	help
	  Belle-sip is a modern library implementing SIP (RFC 3261)
	  transport, transaction and dialog layers.

	  http://www.linphone.org/technical-corner/belle-sip

comment "belle-sip needs a toolchain w/ threads, C++, dynamic library, wchar"
	depends on !BR2_INSTALL_LIBSTDCPP || BR2_STATIC_LIBS || \
		!BR2_TOOLCHAIN_HAS_THREADS || !BR2_USE_WCHAR

comment "belle-sip needs a toolchain not affected by GCC bug 64735"
	depends on BR2_TOOLCHAIN_HAS_GCC_BUG_64735
```

## package/emergunit/Config.in
```kconfig
config BR2_PACKAGE_EMERGUNIT
	bool "emergunit"
	depends on (BR2_PACKAGE_QT5 && BR2_PACKAGE_LIBWT && BR2_PACKAGE_LIBNL && BR2_PACKAGE_LIBNL_TOOLS && BR2_PACKAGE_ALSA_LIB && (BR2_PACKAGE_LINPHONE || BR2_PACKAGE_LINPHONE4))
	help
	  Emergency unit
```

## package/freescale-imx/imx-test/Config.in
```kconfig
comment "imx-test needs an imx-specific kernel to be built"
	depends on BR2_arm && !BR2_LINUX_KERNEL

config BR2_PACKAGE_IMX_TEST
	bool "imx-test"
	depends on BR2_LINUX_KERNEL
	depends on BR2_arm # Only relevant for i.MX
	help
	  Library of userspace helpers specific for the Freescale i.MX
	  platform. 

	  This library is provided by Freescale as-is and doesn't have
	  an upstream.
```

## package/gpio-watch/Config.in
```kconfig
config BR2_PACKAGE_GPIO_WATCH
	bool "gpio-watch"
	help
	  gpio-watch is a tool for running scripts in response to GPIO events

	  https://github.com/larsks/gpio-watch
```

## package/mediastreamer4/Config.in
```kconfig
config BR2_PACKAGE_MEDIASTREAMER4
	bool "mediastreamer4"
	depends on BR2_INSTALL_LIBSTDCPP
	depends on !BR2_STATIC_LIBS
	depends on BR2_TOOLCHAIN_HAS_THREADS # ortp
	depends on !BR2_TOOLCHAIN_HAS_GCC_BUG_64735 # ortp
	depends on BR2_TOOLCHAIN_GCC_AT_LEAST_5 # C++14
	depends on BR2_PACKAGE_SPANDSP
	depends on !BR2_PACKAGE_MEDIASTREAMER
	depends on !BR2_PACKAGE_ORTP
	select BR2_PACKAGE_LIBSRTP
	select BR2_PACKAGE_MBEDTLS4
	select BR2_PACKAGE_ORTP4
	help
	  Mediastreamer is a powerful and lightweighted streaming
	  engine specialized for voice/video telephony applications.

	  It is the library that is responsible for all the receiving
	  and sending of multimedia streams in linphone, including
	  voice/video capture, encoding and decoding, and rendering.

	  http://www.linphone.org/technical-corner/mediastreamer2

comment "mediastreamer needs a toolchain w/ threads, C++, dynamic library, gcc >= 5"
	depends on !BR2_INSTALL_LIBSTDCPP || \
		!BR2_TOOLCHAIN_HAS_THREADS || BR2_STATIC_LIBS || \
		!BR2_TOOLCHAIN_GCC_AT_LEAST_5

comment "mediastreamer needs a toolchain not affected by GCC bug 64735"
	depends on BR2_TOOLCHAIN_HAS_GCC_BUG_64735
```

## package/ortp4/Config.in
```kconfig
config BR2_PACKAGE_ORTP4
	bool "oRTP4"
	depends on BR2_INSTALL_LIBSTDCPP
	depends on BR2_TOOLCHAIN_HAS_THREADS
	depends on !BR2_TOOLCHAIN_HAS_GCC_BUG_64735 # bctoolbox
	depends on !BR2_PACKAGE_ORTP
	depends on !BR2_PACKAGE_BCTOOLBOX
	select BR2_PACKAGE_BCTOOLBOX4
	help
	  oRTP, a Real-time Transport Protocol (RTP,RFC3550) library

	  https://www.linphone.org/technical-corner/ortp

comment "ortp needs a toolchain w/ C++, threads"
	depends on !BR2_INSTALL_LIBSTDCPP || !BR2_TOOLCHAIN_HAS_THREADS

comment "ortp needs a toolchain not affected by GCC bug 64735"
	depends on BR2_TOOLCHAIN_HAS_GCC_BUG_64735
```

## package/rs485-test/Config.in
```kconfig
config BR2_PACKAGE_RS485_TEST
	bool "rs485-test"
	help
	  rs485_test serial port test
```
